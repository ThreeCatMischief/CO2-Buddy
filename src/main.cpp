#include <Arduino.h>
#include <Wire.h>
#include <Adafruit_NeoPixel.h>
#include <esp_sleep.h>
#include <GxEPD2_BW.h>

#include <Fonts/FreeSansBold12pt7b.h>
#include <Fonts/FreeSansBold18pt7b.h>

#define MHZ19C_PWM_PIN 10
#define LED_PIN 8      // Data pin for the LED matrix
#define LED_COUNT 64   // 8x8 matrix = 64 pixels
#define BUTTON_PIN 3
#define uS_TO_S_FACTOR 1000000ULL   // Microseconds to seconds
#define TIME_IN_DEEP_SLEEP 150            // 2.5 min
#define EPD_BUSY  0  // Good
#define EPD_RST   1  // Good
#define EPD_DC    2  // Good (Moved from 2)
#define EPD_CS    20  // Good
//PIN 5 is MOSI, PIN 7 is SCK
#define PREHEAT_TIMER_X 0   // Preheat countdown window, rotated coordinates
#define PREHEAT_TIMER_Y 0
#define PREHEAT_TIMER_W 48
#define PREHEAT_TIMER_H 24  // Multiple of 8 for rotation 1

GxEPD2_BW<GxEPD2_154_GDEY0154D67, GxEPD2_154_GDEY0154D67::HEIGHT> display(GxEPD2_154_GDEY0154D67(EPD_CS, EPD_DC, EPD_RST, EPD_BUSY));

enum CURRENT_STATE {
  PREHEAT,
  GOOD,
  OKAY,
  BAD,
  TOXIC,
  ERROR
};

unsigned long boot_time = 0;
int frame = 0;
int brightness = 150;
int face_duration = 1000; //Faces last 1 second
unsigned long last_face_update = 0;
char current_face[8][8];
int awake_duration = 10000; // 10 seconds
unsigned long awake_until;
bool first_update = true;

// Variables stored in RTC memory to retain values during deep sleep
RTC_DATA_ATTR bool firstboot = true;
RTC_DATA_ATTR CURRENT_STATE last_state;
RTC_DATA_ATTR unsigned long last_epaper_update = 0;

void goToDeepSleep();
void displayState(CURRENT_STATE state);
void bootAnimation();
void firstBootAnimation();
void drawPreheatTimer(int seconds);
int getCO2PPM();
void setBrightness(int b);
void updateEpaper(CURRENT_STATE state, int ppm, bool force_update = false);
CURRENT_STATE getStateForPPM(int ppm);
CURRENT_STATE state = PREHEAT;

Adafruit_NeoPixel strip(LED_COUNT, LED_PIN, NEO_GRB + NEO_KHZ800);

const char face_good[4][8][8] PROGMEM = {
  {{0,0,0,0,0,0,0,0},
  {0,'G','G',0,0,'G','G',0},
  {0,'G','G',0,0,'G','G',0},
  {0,0,0,0,0,0,0,0},
  {0,0,0,0,0,0,0,0},
  {0,'G',0,0,0,0,'G',0},
  {0,0,'G','G','G','G',0,0},
  {0,0,0,0,0,0,0,0}},

  {{0,0,0,0,0,0,0,0},
  {0,0,0,0,0,0,0,0},
  {0,'G','G',0,0,'G','G',0},
  {0,0,0,0,0,0,0,0},
  {0,0,0,0,0,0,0,0},
  {0,'G',0,0,0,0,'G',0},
  {0,0,'G','G','G','G',0,0},
  {0,0,0,0,0,0,0,0}},

  {{0,0,0,0,0,0,0,0},
  {0,0,0,0,0,0,0,0},
  {'G','G','G',0,'G',0,0,'G'},
  {'G',0,  'G',0,'G',0,'G',0},
  {'G',0,  'G',0,'G','G',0,0},
  {'G',0,  'G',0,'G',0,'G',0},
  {'G','G','G',0,'G',0,0,'G'},
  {0,0,0,0,0,0,0,0},},

  {{0,0,0,0,0,0,0,0},
  {0,'G','G',0,0,0,0,0},
  {0,'G','G',0,0,'G','G',0},
  {0,0,0,0,0,0,0,0},
  {0,0,0,0,0,0,0,0},
  {0,'G',0,0,0,0,'G',0},
  {0,0,'G','G','G','G',0,0},
  {0,0,0,0,0,0,0,0},}
};

const char face_OKAY [4][8][8] PROGMEM = {
  {{0,0,0,0,0,0,0,0},
  {0,'Y','Y',0,0,'Y','Y',0},  // Frame 1: Base pose
  {0,'Y','Y',0,0,'Y','Y',0},  // 2x2 wide eyes
  {0,0,0,0,0,0,0,0},
  {0,0,0,0,0,0,0,0},
  {0,0,'Y','Y','Y','Y',0,0},  // Neutral straight mouth
  {0,0,0,0,0,0,0,0},
  {0,0,0,0,0,0,0,0},},
  {{0,0,0,0,0,0,0,0},
  {0,0,0,0,0,0,0,0},
  {0,'Y','Y',0,0,'Y','Y',0},  // Frame 2: "Squint"
  {0,0,0,0,0,0,0,0},        // Eyes are 1 pixel high
  {0,0,0,0,0,0,0,0},
  {0,0,'Y','Y','Y','Y',0,0},  // Mouth stays neutral
  {0,0,0,0,0,0,0,0},
  {0,0,0,0,0,0,0,0},},
  {{0,0,0,0,0,0,0,0},
  {0,'Y',0,0,0,'Y',0,0},    // Frame 3: "Look Left"
  {0,'Y',0,0,0,'Y',0,0},    // Eyes are 2x1 (left-aligned)
  {0,0,0,0,0,0,0,0},
  {0,0,0,0,0,0,0,0},
  {0,'Y','Y','Y','Y',0,0,0},  // Mouth shifts left
  {0,0,0,0,0,0,0,0},
  {0,0,0,0,0,0,0,0},},
  {{0,0,0,0,0,0,0,0},
  {0,'Y','Y',0,0,0,0,0},    // Frame 4: "Look Right"
  {0,'Y','Y',0,0,'Y','Y',0},    // Eyes are 2x1 (right-aligned)
  {0,0,0,0,0,0,0,0},
  {0,0,0,0,0,0,0,0},
  {0,0,'Y','Y','Y','Y',0,0},  // Mouth shifts right
  {0,0,0,0,0,0,0,0},
  {0,0,0,0,0,0,0,0},}
};

const char face_BAD[4][8][8] PROGMEM = {
  { // Frame 1: Base Pose
    {0,0,0,0,0,0,0,0},
    {0,'O','O',0,0,'O','O',0}, // 2x2 wide eyes
    {0,'O','O',0,0,'O','O',0},
    {0,0,0,0,0,0,0,0},
    {0,0,0,0,0,0,0,0},
    {0,0,'O','O','O','O',0,0}, // Base frown (top)
    {0,'O',0,0,0,0,'O',0}, // Base frown (droopy corners)
    {0,0,0,0,0,0,0,0}
  },
  { // Frame 2: Squint
    {0,0,0,0,0,0,0,0},
    {0,0,0,0,0,0,0,0},
    {0,'O','O',0,0,'O','O',0}, // 1-pixel high eyes
    {0,0,0,0,0,0,0,0},
    {0,0,0,0,0,0,0,0},
    {0,0,'O','O','O','O',0,0}, // Same base frown
    {0,'O',0,0,0,0,'O',0},
    {0,0,0,0,0,0,0,0}
  },
  { // Frame 3: "Look Left"
    {0,0,0,0,0,0,0,0},
    {0,'O',0,0,0,'O',0,0},    // 2x1 eyes (left-aligned)
    {0,'O',0,0,0,'O',0,0},
    {0,0,0,0,0,0,0,0},
    {0,0,0,0,0,0,0,0},
    {0,'O','O','O','O',0,0,0}, // Frown shifted left
    {'O',0,0,0,0,'O',0,0},
    {0,0,0,0,0,0,0,0}
  },
  { // Frame 4: "Look Right"
    {0,0,0,0,0,0,0,0},
    {0,0,'O',0,0,0,'O',0},    // 2x1 eyes (right-aligned)
    {0,0,'O',0,0,0,'O',0},
    {0,0,0,0,0,0,0,0},
    {0,0,0,0,0,0,0,0},
    {0,0,0,'O','O','O','O',0}, // Frown shifted right
    {0,0,'O',0,0,0,0,'O'},
    {0,0,0,0,0,0,0,0}
  }
};

const char face_TOXIC[2][8][8] PROGMEM = {
  { // Frame 1: Base Pose
    {0,0,0,0,0,0,0,0},
    {0,'R',0,0,0,0,'R',0}, // Angry eye (top-left)
    {0,'R','R',0,0,'R','R',0}, // Angry eye (bottom-right)
    {0,0,0,0,0,0,0,0},
    {0,0,0,0,0,0,0,0},
    {0,0,'R','R','R','R',0,0}, // Wide frown (corners)
    {0,'R',0,0,0,0,'R',0}, // Wide frown (base)
    {0,0,0,0,0,0,0,0}
  },
  { // Frame 2: Squint
    {'R',0,'R',0,0,'R',0,'R'},
    {0,'R',0,0,0,0,'R',0},
    {'R',0,'R',0,0,'R',0,'R'}, // Squinted angry eyes (just the bottom row)
    {0,0,0,0,0,0,0,0},
    {0,0,0,0,0,0,0,0},
    {0,0,0,0,0,0,0,0}, // Same wide frown
    {0,'R','R','R','R','R','R',0},
    {0,'R',0,0,0,0,'R',0}
  }
};

const char error[8][8] PROGMEM = {
  {'R',0,0,0,0,0,0,'R'},
  {0,'R',0,0,0,0,'R',0},
  {0,0,'R',0,0,'R',0,0},
  {0,0,0,'R','R',0,0,0},
  {0,0,0,'R','R',0,0,0},
  {0,0,'R',0,0,'R',0,0},
  {0,'R',0,0,0,0,'R',0},
  {'R',0,0,0,0,0,0,'R'},
};

const char fire[3][8][8] PROGMEM = {
  {
    {0,0,0,0,0,1,0,0},
    {0,1,0,0,0,1,1,0},
    {0,1,1,0,1,2,1,0},
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    {4,4,4,5,5,5,5,5}
  },{
    {0,0,0,0,0,0,0,0},
    {0,0,0,0,0,1,0,0},
    {0,1,1,0,1,2,1,0},
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    {4,4,4,5,5,5,5,5}
  },{
    {0,0,0,0,0,0,0,0},
    {0,0,0,0,1,0,0,0},
    {0,0,1,0,1,1,0,0},
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    {4,4,4,5,5,5,5,5}
  }
};

const char boot_animation[5][8][8] PROGMEM = {
  { // Frame 1: 2x2 centered box
    {0,0,0,0,0,0,0,0},
    {0,0,0,0,0,0,0,0},
    {0,0,0,0,0,0,0,0},
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    {0,0,0,0,0,0,0,0}
  },{ // Frame 2: 4x4 centered box
    {0,0,0,0,0,0,0,0},
    {0,0,0,0,0,0,0,0},
    {0,0,1,1,1,1,0,0},
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    {0,0,0,0,0,0,0,0}
  },{ // Frame 3: 6x6 centered box
    {0,0,0,0,0,0,0,0},
    {0,1,1,1,1,1,1,0},
    {0,1,1,1,1,1,1,0},
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    {0,0,0,0,0,0,0,0}
  },{ // Frame 4: 8x8 full box
    {1,1,1,1,1,1,1,1},
    {1,1,1,1,1,1,1,1},
    {1,1,1,1,1,1,1,1},
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    {1,1,1,1,1,1,1,1}
  },{ // Frame 5: All OFF (blink to finish)
    {0,0,0,0,0,0,0,0},
    {0,0,0,0,0,0,0,0},
    {0,0,0,0,0,0,0,0},
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    {0,0,0,0,0,0,0,0}
  }
};

// array size is 4014
const unsigned char fire_bitmap[] PROGMEM  = {
  // 'fire', 200x200px
  0xff, 0xff, 0xff, 0xff, 0xff, 0xff, 0xff, 0xff, 0xff, 0xff, 0xff, 0xff, 0xff, 0xff, 0xff, 0xff, 
  0xff, 0xff, 0xff, 0xff, 0xff, 0xff, 0xff, 0xff, 0xff, 0xff, 0xff, 0xff, 0xff, 0xff, 0xff, 0xff, 
  0xff, 0xff, 0xff, 0xff, 0xff, 0xff, 0xff, 0xff, 0xff, 0xff, 0xff, 0xff, 0xff, 0xff, 0xff, 0xff, 
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  0xff, 0xff, 0xff, 0xff, 0xff, 0xff, 0xff, 0xff
};

struct ColorLookup {
  char code;
  uint32_t color;
};

const ColorLookup colors[] = {
  {'G', strip.Color(0, 200, 0)},
  {'Y', strip.Color(255, 215, 0)},
  {'O', strip.Color(255, 140, 0)},
  {'R', strip.Color(255, 0, 0)},
  {0, strip.Color(0, 0, 0)},
  {1, strip.Color(213, 0, 0)},
  {2, strip.Color(229, 57, 53)},
  {3, strip.Color(244, 67, 54)},
  {4, strip.Color(255, 87, 34)},
  {5, strip.Color(255, 152, 0)}
};



void setup() {
  pinMode(MHZ19C_PWM_PIN, INPUT);
  pinMode(BUTTON_PIN, INPUT);
  SPI.begin(7, -1, 5, -1); // SCK=7, MISO=N/A, MOSI=5, SS=N/A
  Serial.begin(115200);
  Serial.println("CO2 Monitor Starting...");
  strip.begin();
  strip.clear();           // Turn all pixels off
  strip.show(); 
  display.init(115200);
  display.setFullWindow();
  display.firstPage();
  display.fillScreen(GxEPD_WHITE);
  if(firstboot) {
    display.setRotation(1);
    display.drawBitmap(0, 0, fire_bitmap, 200, 200, GxEPD_BLACK);
    display.display();
    firstBootAnimation();
  } else {
    Serial.println("Woke from deep sleep, already preheated");
  }
  awake_duration = 15000;
  brightness = 70;
  if(esp_sleep_get_wakeup_cause() == ESP_SLEEP_WAKEUP_TIMER) {
    if(getStateForPPM(getCO2PPM()) == last_state) { // No change in state, dim and short awake
      brightness = 10;
      awake_duration = 3000;
    } else { // Change in state, normal brightness and duration
      brightness = 150;
      awake_duration = 5000;
    }    
  } else if(!firstboot) { // Button wakeup
    brightness = 120;
    awake_duration = 5000;
    bootAnimation();
    Serial.println("Last state was: " + String(last_state));
    displayState(last_state);
  }
  awake_until = millis() + awake_duration;
  firstboot = false;
}

void loop() {
  if(millis() < awake_until) {
    Serial.println("Brightness: " + String(brightness));
    Serial.println("Sleep Duration: " + String(face_duration));
    int ppm = getCO2PPM();
    state = getStateForPPM(ppm);
    displayState(state);
    updateEpaper(state, ppm, first_update);
    first_update = false;
    delay(150);
  } else {
    goToDeepSleep();
  }
}

void firstBootAnimation() {
  unsigned long preheat_complete = millis() + 70000; // 70 s preheat
  int shown_seconds = -1;
  display.setPartialWindow(PREHEAT_TIMER_X, PREHEAT_TIMER_Y, PREHEAT_TIMER_W, PREHEAT_TIMER_H);
  while(millis() < preheat_complete) {
    int seconds_left = (preheat_complete - millis() + 9999) / 10000 * 10; // Round up to 10 s steps
    if(seconds_left != shown_seconds) {
      drawPreheatTimer(seconds_left);
      shown_seconds = seconds_left;
    }
    displayState(PREHEAT);
    Serial.println("Preheating for another " + String((preheat_complete - millis()) / 1000) + " seconds...");
    delay(150);
  }
  display.setFullWindow(); // First reading after preheat does a full refresh
  Serial.println("Preheat complete.");
}

// Partial refresh of the top-left corner only. The boot bitmap is redrawn inside
// the window so the background matches; its set bits are drawn black, hence white text.
void drawPreheatTimer(int seconds) {
  do {
    display.fillRect(PREHEAT_TIMER_X, PREHEAT_TIMER_Y, PREHEAT_TIMER_W, PREHEAT_TIMER_H, GxEPD_WHITE);
    display.drawBitmap(0, 0, fire_bitmap, 200, 200, GxEPD_BLACK);
    display.setTextColor(GxEPD_WHITE);
    display.setFont(&FreeSansBold12pt7b);
    display.setCursor(PREHEAT_TIMER_X + 3, PREHEAT_TIMER_Y + 20);
    display.print(String(seconds) + "s");
  } while(display.nextPage());
}

int getCO2PPM() {
  unsigned long awake_duration_left = awake_until - millis();
  float co2ppm = 0;
  unsigned long highTime = pulseIn(MHZ19C_PWM_PIN, HIGH, 5000000); // 5s timeout
  unsigned long lowTime = pulseIn(MHZ19C_PWM_PIN, LOW, 5000000);

  // pulseIn() returns microseconds; datasheet offsets are 2 ms and 4 ms
  if (highTime >= 2000 && lowTime >= 2000) {
      unsigned long period = highTime + lowTime;
      co2ppm = 2000.0 * (highTime - 2000) / (period - 4000);

      Serial.print("CO2 ppm: ");
      Serial.println(co2ppm);
  } else {
      Serial.println("Invalid reading. State: ERROR");
      return -1;
  }
  if(first_update) awake_until = millis() + awake_duration_left; // Restore awake duration
  return (int)co2ppm;
}

CURRENT_STATE getStateForPPM(int ppm) {
  if(ppm < 0) {
    return ERROR;
  } else if(ppm < 600) {
    return GOOD;
  } else if(ppm < 1000) {
    return OKAY;
  } else if(ppm < 1500) {
    return BAD;
  } else {
    return TOXIC;
  }
}

String getNameOfState(CURRENT_STATE state) {
  switch(state) {
    case(PREHEAT):
      return "PREHEAT";
    case(GOOD):
      return "GOOD";
    case(OKAY):
      return "OKAY";
    case(BAD):
      return "BAD";
    case(TOXIC):
      return "TOXIC";
    case(ERROR):
      return "ERROR";
    default:
      return "UNKNOWN";
  }
}

void displayState(CURRENT_STATE state) {
  if(millis() - last_face_update >= face_duration) { // Time to update face
    if(awake_until - millis() < 1000) { // Less than 1 second left, extend awake time
      awake_until = millis() + 750;
    }
    switch(state) {
      case(PREHEAT):
        memcpy_P(current_face, fire[frame % 3], sizeof(current_face));
        frame++;
        break;
      case(GOOD):
        memcpy_P(current_face, face_good[rand() % 4], sizeof(current_face));
        break;
      case(OKAY):
        memcpy_P(current_face, face_OKAY[rand() % 4], sizeof(current_face));
        break;
      case(BAD):
        memcpy_P(current_face, face_BAD[rand() % 4], sizeof(current_face));
        break;
      case(TOXIC):
        memcpy_P(current_face, face_TOXIC[rand() % 2], sizeof(current_face));
        break;
      case(ERROR):
        memcpy_P(current_face, error, sizeof(current_face));
        break;
    }
    last_face_update = millis();

    // Update the LED matrix
    for(int y = 0; y < 8; y++) {
      for(int x = 0; x < 8; x++) {
        char code = current_face[7-x][y];
        uint32_t color = strip.Color(0, 0, 0); // Default to off
        for (const auto& entry : colors) {
          if (entry.code == code) {
            color = entry.color;
            break;
          }
        }
        strip.setPixelColor(y * 8 + x, color);
      }
    }
  }
  strip.setBrightness(brightness);
  strip.show();
  frame++;
}

void bootAnimation() {
  for(int i = 0; i < 5; i++) {
    memcpy_P(current_face, boot_animation[i], sizeof(current_face));
    // Update the LED matrix
    for(int y = 0; y < 8; y++) {
      for(int x = 0; x < 8; x++) {
        char code = current_face[7-x][y];
        uint32_t color = strip.Color(0, 0, 0); // Default to off
        for (const auto& entry : colors) {
          if (entry.code == code) {
            color = entry.color;
            break;
          }
        }
        strip.setPixelColor(y * 8 + x, color);
      }
    }
    strip.setBrightness(brightness);
    strip.show();
    delay(300);
  }
}

void goToDeepSleep() {
  Serial.println("Entering deep sleep mode...");
  strip.clear();
  strip.show();
  Serial.flush();
  last_state = state;

  // 2. Tell the ESP32 to wake up if any pin in the mask goes HIGH
  esp_sleep_enable_gpio_wakeup();
  esp_deep_sleep_enable_gpio_wakeup((1ull << BUTTON_PIN), ESP_GPIO_WAKEUP_GPIO_HIGH);
  esp_sleep_enable_timer_wakeup(TIME_IN_DEEP_SLEEP * uS_TO_S_FACTOR);
  
  // --- END OF FIX ---

  esp_deep_sleep_start();
}

void updateEpaper(CURRENT_STATE state, int ppm, bool force_update) {
  if(millis() - last_epaper_update >= 60000 || state != last_state || force_update) { // Update every minute or on state change
    last_epaper_update = millis();
    last_state = state;
    do {
      display.fillScreen(GxEPD_WHITE);
      display.setTextColor(GxEPD_BLACK);
      display.setRotation(1);
      display.setFont(&FreeSansBold12pt7b);
      display.setCursor(35, 35);
      display.print("CO2 PPM: ");
      display.setFont(&FreeSansBold18pt7b);
      display.setCursor(60, 75);
      display.print(ppm);
      display.drawFastHLine(0, 90, 200, GxEPD_BLACK);
      display.setCursor(30, 125);
      display.setFont(&FreeSansBold12pt7b);
      display.print("Air Quality:");
      display.setCursor(45, 165);
      display.setFont(&FreeSansBold18pt7b);
      display.print(String(getNameOfState(state)));
      
    } while (display.nextPage());
  } else Serial.println("E-paper update not needed yet.");
}